
#include "./apps/_experiments/kissme.h"

#include <gfx_util.h>
#include <osw_app.h>
#include <osw_hal.h>

#include "osw_ui.h"

// define global scope variables
bool showHeart = false;

void OswAppKissMe::setup()
{
  // this is where you initialise code, gets called when this app is shown
}

// 'Heart_icon.png',
// Target size 80x80px
const uint8_t Heart_icon_width = 80;
uint8_t Heart_icon[] PROGMEM = {
    0x00, 0x00, 0x00, 0x00, 0x00, 0x00, 0x00, 0x00, 0x00, 0x00, 0x00, 0x00, 0x00, 0x00, 0x00, 0x00, 0x00, 0x00, 0x00,
    0x00, 0x00, 0x00, 0x7f, 0xf0, 0x00, 0x00, 0x0f, 0xfe, 0x00, 0x00, 0x00, 0x03, 0xff, 0xfe, 0x00, 0x00, 0x7f, 0xff,
    0xc0, 0x00, 0x00, 0x0f, 0xf0, 0x7f, 0x80, 0x01, 0xfe, 0x0f, 0xf0, 0x00, 0x00, 0x1f, 0x80, 0x0f, 0xc0, 0x03, 0xf0,
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    0x00, 0x00};

void OswAppKissMe::loop()
{
  OswHal *hal = OswHal::getInstance();
  if (hal->btnHasGoneDown(BUTTON_3))
  {
    showHeart = true;
  }
  if (hal->btnHasGoneDown(BUTTON_2))
  {
    showHeart = false;
  }
  hal->gfx()->fill(0);

  // Show Buttons
  hal->gfx()->resetText();
  hal->gfx()->setTextColor(rgb565(255, 255, 255), rgb565(0, 0, 0));
  if (showHeart)
  {
    // Button 2 - bottom right
    OswUI::getInstance()->setTextCursor(BUTTON_2);
    hal->gfx()->setTextColor(rgb565(255, 255, 255), rgb565(0, 0, 0));
    hal->gfx()->print("Done");
  }
  else
  {
    // Button 3 - top right
    OswUI::getInstance()->setTextCursor(BUTTON_3);
    hal->gfx()->setTextColor(rgb565(255, 255, 255), rgb565(0, 0, 0));
    hal->gfx()->print("Click");
  }

  // Show Heart
  if (showHeart)
  {
    hal->gfx()->resetText();
    hal->gfx()->setTextSize(2);
    hal->gfx()->setTextColor(rgb565(255 - intervall, 0, 0), rgb565(0, 0, 0));
    hal->gfx()->setTextCenterAligned();
    // hal->gfx()->setTextCursor(120 - hal->gfx()->getTextOfsetColumns(2), 120 - hal->gfx()->getCharHeight(' '));
    hal->gfx()->setTextCursor(120, 120 - hal->gfx()->getCharHeight(' '));
    hal->gfx()->print("KISS");
    // hal->gfx()->setTextCursor(120 - hal->gfx()->getTextOfsetColumns(1.5), 120 + hal->gfx()->getCharHeight(' '));
    hal->gfx()->setTextCursor(120, 120 + hal->gfx()->getCharHeight(' '));
    hal->gfx()->print("ME!");
    uint16_t x0 = 120 - Heart_icon_width / 2;
    uint16_t y0 = 120 - Heart_icon_width / 2;
    uint16_t h = Heart_icon_width;
    uint16_t cnt = Heart_icon_width / 8;

    hal->getCanvas()->drawBWBitmap(x0, y0, cnt, h, Heart_icon, rgb565(255 - intervall, 0, 0));
  }
  hal->requestFlush(); // request the screen to be updated. refreshrate is handled by main loop

  // increase intervall
  intervall += diff;
  if (intervall <= 0 || intervall >= 120)
  {
    diff = -diff;
  }
}

void OswAppKissMe::stop()
{
  // this is where you de-initialize stuff, gets called when another app is shown
}
